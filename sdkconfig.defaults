## sdkconfig.defaults
```kconfig
CONFIG_BOOTLOADER_APP_ROLLBACK_ENABLE=y
CONFIG_FREERTOS_HZ=1000
CONFIG_COMPILER_CXX_EXCEPTIONS=y
CONFIG_AUTOSTART_ARDUINO=y
CONFIG_ESP_INSIGHTS_ENABLED=n
CONFIG_ESP_RMAKER_ENABLED=n
CONFIG_ESP_RAINMAKER_ENABLED=n
CONFIG_ESP_INSIGHTS_TRANSPORT_HTTPS=n
CONFIG_ESP_INSIGHTS_TRANSPORT_MQTT=n
CONFIG_ESP_TLS_CLIENT_SESSION_TICKETS=y
CONFIG_MBEDTLS_PSK_MODES=y
CONFIG_MBEDTLS_KEY_EXCHANGE_PSK=y
```
